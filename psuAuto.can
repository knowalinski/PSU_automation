/*@!Encoding:1250*/
variables
{
	dword automationFile;
	char onCommand[81] = "{\"channel\": \"2\", \"state\": \"1\", \"params\": {\"voltage\": \"24.0\", \"current\": \"06.0\"}}";
  char offCommand[81] = "{\"channel\": \"2\", \"state\": \"0\", \"params\": {\"voltage\": \"24.0\", \"current\": \"06.0\"}}";

}

on start
{
	setFilePath("C:\\client", 1);
	automationFile = openFileWrite("capl_input.txt", 1);
	filePutString(onCommand, 81, automationFile);
	fileClose(automationFile);
}

on stopMeasurement
{
	setFilePath("C:\\client",1);
	automationFile = openFileWrite("capl_input.txt", 1);
	filePutString(offCommand, 81, automationFile);
	fileClose(automationFile);
}
